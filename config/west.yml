## config/west.yml
```yaml
manifest:
  remotes:
    - name: zmkfirmware
      url-base: https://github.com/zmkfirmware
    - name: zmkmouse
      url-base: https://github.com/petejohanson/
  projects:
    - name: zmk
      remote: zmkfirmware
      revision: main
      import: app/west.yml
    - name: zmkmouse
      revision: feat/pointers-move-scroll
      import: app/west.yml
  self:
    path: config
```
